<div class="pageHeadCentered">NHRC-6 Bridging Repeater Controller</div>
<table border=0 width="100%">
  <tr>
    <td>
The NHRC-6 is an advanced, low cost bridging repeater controller.  It has a
highly integrated design, using state-of-the-art components, which results
in a powerful controller with a low parts count.  This increases reliability
and lowers cost.<p>
This controller can be used to control two duplex repeaters, a duplex repeater with
a link radio, or to build a <b>bi-directional cross band repeater</b> with
simplex radios.<p>
</td>
    <td align=center valign=top>
<a href="nhrc-6-image.php"><img src="nhrc-6-small.jpg" width=300 height=283 alt="[Picture of NHRC-6 Controller]" border=0></a><p>
<a href="nhrc-cab-6-image.php"><img src="cab-6-small.jpg" width=300 height=35 alt="[Picture of NHRC-CAB-6 Rack Chassis]" border=0></a><br>

<b>Click image to view a bigger picture.</b>
    </td>
  </tr>
</table>
The NHRC-6 has two radio ports.  Each radio port supports a receiver and a
transmitter.  Each receiver is individually configurable.  Receiver
configuration includes such parameters as receiver enable (on/off),
access mode (CAS, CAS and CTCSS, CAS or CTCSS, and DTMF,) timeout timer
enable, and DTMF muting.  Each receiver can specify which transmitter(s)
will be used to repeat the receiver's audio.<p>
Each transmitter is also individually configurable.  Transmitter controls
include transmitter enable (on/off), hang time enable, courtesy tone
enable, ID enable and selection of one of two CW ID messages.<p>
The architecture of the NHRC-6 allows the controller to be used in a
variety of different applications.  These applications include
simultaneous control of two repeaters, each with it's own ID message,
control of a repeater with a link radio, including linking modes
compatible with IRLP and full-duplex link environments, as well as the
controller forming a "bridge" in conjunction with two simplex radios,
allowing simple and reliable linking of completely separate radio systems.
<p>
<div class="productFeatures">Features:</div>
<ul>
  <li>Two radio ports.
  <li>Can support the following configurations:
  <ul>
    <li>two duplex repeaters.
    <li>duplex repeater with link radio.
    <li>two back-to-back simplex radios.
  </ul>
  <li>Carrier, Carrier and CTCSS, Carrier or CTCSS and DTMF Access Modes.
  <li>&quot;Intelligent&quot; ID algorithm.
  <li>55 Control Operator Settings.
  <li>Six User Commands.
  <li>Five saved setups.
  <li>Distinctive Courtesy Tones indicates active receiver ports.
  <li>Dedicated Fan Control Output/Digital Output.
  <li>Touch-Tone remote control and programming.
  <li>Hang timer, ID timer, Timeout timers, Fan Timer, and CW messages stored in non-volatile memory.
  <li>Individual audio gating on each port allows use of non-squelched receiver audio.
  <li>Jumper-selectable receiver deemphasis.
  <li>LED <img src="../resources/green-ball.gif" width=12 height=12>CAS,
	<img src="../resources/green-ball.gif" width=12 height=12>CTCSS,
	<img src="../resources/red-ball.gif" width=12 height=12>PTT,
	and <img src="../resources/yellow-ball.gif" width=12 height=12>DTMF indicators
	for each port.
  <li>Connectors for each port to attach optional <a href="/nhrc-dad/">NHRC-DAD</a>
Digital Audio Delays, to fully mute DTMF and help eliminate Squelch Crashes.
</ul>
<div class="productFeatures">Documentation:</div>
<ul>
  <li><a href="nhrc-6-manual-20040301.pdf">NHRC-6 User Guide</a>
        <img src="/resources/pdficonsmall.gif" width=22 height=24 border=0 alt="PDF icon"> (~400K, March 1, 2004 revision)
</ul>
<div class="productFeatures">Accessories:</div>
<ul>
    <li><a href="/cables/index.php">Radio Interconnect Cables</a> for popular radios and repeaters
    <li><a href="/nhrc-squelch/index.php">NHRC-Squelch</a> Intelligent Carrier-Activated Switch for Repeaters
    <li><a href="/nhrc-dad/index.php">NHRC-DAD</a> Digital Audio Delay
</ul>
<div class="productFeatures">Pricing:</div>
<blockquote>
  <table border=0 cellspacing=2>
    <tr>
      <td bgcolor=#00ccff valign=top>NHRC-6</td>
      <td bgcolor=#00ccff>Dual Repeater Controller</td>
      <td bgcolor=#00ccff align=right valign=top><font color="red">Special Order Only<br>Contact Factory</font></td>
    </tr>
    <tr>
      <td bgcolor=#00ffcc valign=top>NHRC-CAB-6</td>
      <td bgcolor=#00ffcc>Rack Chassis</td>
      <td bgcolor=#00ffcc align="right">$60</td>
    </tr>
    <tr>
      <td bgcolor=#00ccff valign=top>Shipping &amp; Handling</td>
      <td bgcolor=#00ccff>&nbsp;</td>
      <td bgcolor=#00ccff>See <a href="/shipping.php">Shipping Info</a></td>
    </tr>
  </table>
</blockquote>
