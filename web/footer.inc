</tr>
</table>
</td></tr></table>
<div class="pageFooter">
<?php
date_default_timezone_set('America/New_York');
if ($version != "") {
echo $_SERVER['PHP_SELF'] . ", version $version, last modified " . date ("d F Y H:i", getlastmod()) . "<br>\n";
}
if ($copydate != "") {
echo "Copyright &#169; $copydate, NHRC LLC, all rights reserved.<br>";
}
?>
Mail comments to
<script language="javascript" type="text/javascript">
mto = "\155\x61\u0069\x6c\164\x6f\u003a"
addr = "\x77\x65\x62\155\141\x73\u0074\141\x68\u0040\156\150\162\143\u002e\156\145\164"
document.writeln('\x3ca href="'+mto+addr+'">'+addr+'\x3c/a>')
</script>
<br>
</div>
<!-- analytics -->
<script type="text/javascript">
var gaJsHost = (("https:" == document.location.protocol) ? "https://ssl." : "http://www.");
document.write(unescape("%3Cscript src='" + gaJsHost + "google-analytics.com/ga.js' type='text/javascript'%3E%3C/script%3E"));
</script>
<script type="text/javascript">
try {
var pageTracker = _gat._getTracker("UA-122442-1");
pageTracker._trackPageview();
} catch(err) {}</script>
<!--
<script>
  (function(i,s,o,g,r,a,m){i['GoogleAnalyticsObject']=r;i[r]=i[r]||function(){
  (i[r].q=i[r].q||[]).push(arguments)},i[r].l=1*new Date();a=s.createElement(o),
  m=s.getElementsByTagName(o)[0];a.async=1;a.src=g;m.parentNode.insertBefore(a,m)
  })(window,document,'script','//www.google-analytics.com/analytics.js','ga');

  ga('create', 'UA-122442-1', 'nhrc.net');
  ga('require', 'displayfeatures');
  ga('send', 'pageview');

</script>
-->
</body>
</html>
