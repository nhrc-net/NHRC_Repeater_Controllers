<div class="pageHeadCentered">NHRC-7 Bridging Repeater Controller</div>
<table border=0 width="100%">
  <tr>
    <td>
The NHRC-7 is an enhanced version of NHRC's popular <a href="/nhrc-6/">NHRC-6</a>
repeater controller.  It includes all the features of the NHRC-6, and adds
an additional DTMF decoder for a dedicated control receiver input, four digital
inputs for alarm and/or telemetry, flexible CTCSS encoder control, and up to
four digital outputs for control applications. <p>
Just like the NHRC-6, this controller can be used to control two duplex repeaters,
a duplex repeater with a link radio, or it can be used to create a variety of
radio bridging applications, including a <b>bi-directional cross band repeater</b> with
simplex or duplex radios.<p>
</td>
    <td align=center valign=top>
<a href="nhrc-7-image.php"><img src="nhrc-7-small.jpg" width=300 height=212 alt="[Picture of NHRC-7 Controller]" border=0></a><p>
<a href="nhrc-cab-2-image.php"><img src="cab-2-small.jpg" width=300 height=35 alt="[Picture of NHRC-CAB-2 Rack Chassis]" border=0></a><br>
Click image to view a bigger picture.
    </td>
  </tr>
</table>
The NHRC-7 has two radio ports.  Each radio port supports a receiver and a
transmitter.  Each receiver is individually configurable.  Receiver
configuration includes such parameters as receiver enable (on/off),
access mode (CAS, CAS and CTCSS, CAS or CTCSS, and DTMF,) timeout timer
enable, and DTMF muting.  Each receiver can specify which transmitter(s)
will be used to repeat the receiver's audio.<p>
Each transmitter is also individually configurable.  Transmitter controls
include transmitter enable (on/off), hang time enable, courtesy tone
enable, ID enable and selection of one of two CW ID messages.<p>
The architecture of the NHRC-7 allows the controller to be used in a
variety of different applications.  These applications include
simultaneous control of two repeaters, each with it's own ID message,
control of a repeater with a link radio, including linking modes
compatible with IRLP and full-duplex link environments, as well as the
controller forming a "bridge" in conjunction with two transceivers,
allowing simple and reliable linking of completely separate radio systems.
<p>
<div class="productFeatures">Features:</div>
<ul>
  <li>Two radio ports.
  <li>Three DTMF decoders
    <ul>
      <li>Radio 1
      <li>Radio 2
      <li>Control Receiver
    </ul>
  <li>Can support the following configurations:
  <ul>
    <li>two duplex repeaters.
    <li>duplex repeater with link radio.
    <li>two back-to-back transceivers.
  </ul>
  <li>Carrier, Carrier and CTCSS, Carrier or CTCSS and DTMF Access Modes.
  <li>&quot;Intelligent&quot; ID algorithm.
  <li>Flexible CTCSS Encoder Control.
  <li>56 Control Operator Settings.
  <li>Eight User Commands.
  <li>Five saved setups.
  <li>Distinctive Courtesy Tones indicates active receiver ports.
  <li>Dedicated Fan Control Output/Digital Output.
  <li>Four digital inputs for alarm and/or telemetry.
  <li>Two or Four digital outputs for remote control applications.
  <li>Touch-Tone remote control and programming.
  <li>Hang timer, ID timer, Timeout timers, Fan Timer, and CW messages stored in non-volatile memory.
  <li>Individual audio gating on each port allows use of non-squelched receiver audio.
  <li>Jumper-selectable receiver deemphasis.
  <li>LED <img src="../resources/green-ball.gif" width=12 height=12 alt="*">CAS,
	<img src="../resources/green-ball.gif" width=12 height=12 alt="*">CTCSS,
	<img src="../resources/red-ball.gif" width=12 height=12 alt="*">PTT,
	and <img src="../resources/yellow-ball.gif" width=12 height=12 alt="*">DTMF indicators
	for each port.
  <li>Connectors for each port to attach optional <a href="/nhrc-dad/">NHRC-DAD</a>
Digital Audio Delays, to fully mute DTMF and help eliminate Squelch Crashes.
</ul>
<div class="productFeatures">Documentation:</div>
<ul>
  <li><a href="nhrc-7-manual-20041224.pdf">NHRC-7 User Guide</a>
        <img src="/resources/pdficonsmall.gif" width=22 height=24 border=0 alt="PDF icon"> (2004-12-14 version, Rev. A & Rev B PCB, 390 KB PDF)
  <li><a href="nhrc-7-manual-20060809.pdf">NHRC-7 User Guide</a>
        <img src="/resources/pdficonsmall.gif" width=22 height=24 border=0 alt="PDF icon"> (2006-08-09 version, Rev. C PCB, 1500 KB PDF)
  <li><a href="nhrc-7-manual-20120108.pdf">NHRC-7 User Guide</a>
        <img src="/resources/pdficonsmall.gif" width=22 height=24 border=0 alt="PDF icon"> (2012-01-09 version, Rev. C PCB, 1800 KB PDF)
</ul>
<div class="productFeatures">Accessories:</div>
<ul>
    <li><a href="/nhrc-squelch/index.php">NHRC-Squelch</a> Intelligent Carrier-Activated Switch for Repeaters
    <li><a href="/nhrc-dad-2/index.php">NHRC-DAD-2</a> Digital Audio Delay
</ul>
<div class="productFeatures">Pricing:</div>
<blockquote>
  <table border=0 cellspacing=2>
    <tr>
      <td bgcolor="#00ccff" valign="top">NHRC-7</td>
      <td bgcolor="#00ccff" valign="top">Bridging Repeater Controller</td>
      <td bgcolor="#00ccff" align="right" valign="top">$289.00</td>
    </tr>
    <tr>
      <td bgcolor="#00ffcc" valign=top>NHRC-CAB-2</td>
      <td bgcolor="#00ffcc">NHRC-7 Rack Chassis</td>
      <td bgcolor="#00ffcc" align="right">$70.00</td>
    </tr>
    <tr>
      <td bgcolor="#00ccff" valign=top>Shipping &amp; Handling</td>
      <td bgcolor="#00ccff">&nbsp</td>
      <td bgcolor="#00ccff" align="right" valign="top">See <a href="/shipping.php">Shipping Info</a></td>
    </tr>
  </table>
</blockquote>
